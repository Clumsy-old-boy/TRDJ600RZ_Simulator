/**
  ******************************************************************************
  * @file    SpindleSim.c
  * @brief   Implementation of the spindle simulator (quadrature A/B + Z)
  * @version 1.0
  * @date    2026-09-14
  * @hardware NUCLEO-G431KB (STM32G431KBTx, LQFP32) @ 170 MHz
  * @compiler ARM Compiler 6 (Keil uVision AC6)
  ******************************************************************************
  *
  * WAVEFORM GENERATION ARCHITECTURE
  * ----------------------------------------------------------------------------
  *   Two synchronized timers. TIM3 generates A and B with an up-counting counter
  *   and two channels in OUTPUT COMPARE toggling at every match ("toggle on match"):
  *
  *       CCR1 = (ARR+1)/4          ->  A on PA6 (TIM3_CH1)
  *       CCR2 = 3*(ARR+1)/4        ->  B on PA4 (TIM3_CH2)
  *
  *   Index Z is generated by TIM2 on PA0 in PWM mode 1, one pulse per revolution, counted by the TIM3 update events (External Clock Mode 1, ITR2):
  *   ARR = 2*SPINDLE_SIM_PPR - 1 = 1199 (1200 events = 600 A/B periods), pulse 2 events wide (one A/B period), active high, T/8 before the A edge.
  *
  *   In toggle mode each channel produces a single edge per counter period,
  *   therefore the output is always at 50 % and the compare value only fixes its
  *   phase: the waveform period is 2*(PSC+1)*(ARR+1) ticks and the distance between
  *   the compare values of A and B, equal to (ARR+1)/2, corresponds to T/4. The four
  *   transitions of A and B are therefore equally spaced and the TIM1 counter in
  *   encoder mode x4 advances by 4 counts per period, with no possibility of
  *   reversal caused by simultaneous edges.
  *
  *   Z is one pulse per revolution: 1200 TIM3 update events, that is 600 periods of
  *   A/B. TIM2 is clocked by those events (External Clock Mode 1, ITR2) and
  *   the pulse lasts 2 events, that is one A/B period; it starts at the clearing of
  *   the TIM2 counter, which occurs on the TIM3 update event: with respect to the rising edge of A
  *   the pulse therefore begins T/8 earlier (198.4 us at 630 Hz).
  *   The CH3 channel of TIM3 remains configured by MX_TIM3_Init() but is not
  *   enabled: PB0 does not generate any signal.
  *
  *   The rotation direction is reversed by swapping the compare values of
  *   A and B, so it can be changed at runtime with SpindleSim_SetDirection().
  *
  *   For the speed change the ARR preload (ARPE) and the CCR preload (OCxPE) are
  *   used, both enabled by MX_TIM3_Init(): by writing the CCRs first and then
  *   ARR, the new geometry is loaded in one piece at the next update
  *   event, with no glitch on A, B or Z.
  *
  * COMPILATION NOTES
  * ----------------------------------------------------------------------------
  *   - The module uses no interrupts: generation and counting take place
  *     entirely in hardware and the only software processing is the speed
  *     estimate of SpindleSim_MeasureRpm(), called from the main loop.
  *   - No library function is used: the floating point conversions are limited
  *     to single precision multiplications and divisions, resolved by
  *     the Cortex-M4 FPU.
  *   - The peripheral is managed through the STM32CubeG4 HAL libraries and the
  *     CMSIS macros of the STM32G4 family (__HAL_TIM_*).
  *
  ******************************************************************************
  */

#include "SpindleSim.h"

/* ============================================================================
  * PRIVATE VARIABLES
  * ============================================================================ */

/* TIM3 handle, defined in main.c and initialized by MX_TIM3_Init() */
extern TIM_HandleTypeDef htim3;

/* TIM2 handle, defined in main.c and initialized by MX_TIM2_Init():
   it generates index Z on PA0, one pulse per revolution (External Clock Mode 1, ITR2) */
extern TIM_HandleTypeDef htim2;


/**
  * @brief  Simulator state
  * @note   Structure private to the module: it is accessed only through the
  *         public API declared in SpindleSim.h.
  */
static struct {
    float    rpm;           /* Actual speed [rpm]                     */
    uint32_t psc;           /* Prescaler applied to TIM3              */
    uint32_t arr;           /* Auto-reload applied to TIM3            */
    uint32_t pwm_hz;        /* Actual A/B frequency [Hz]              */
    uint8_t  running;       /* 1 = rotation in progress               */
    uint8_t  reverse;       /* 1 = reversed direction                 */
} sim = {0};

/**
  * @brief  State of the speed meter based on the TIM3 counter
  * @note   All fields are updated by SpindleSim_MeasureRpm(), called from the
  *         application context and never from the interrupt context.
  */
static struct {
    uint32_t last_tick;     /* HAL_GetTick() of the last estimate        */
    uint32_t accum;         /* Accumulator modulo the half period        */
    uint16_t last_cnt;      /* Counter reduced to the half period        */
    uint32_t transitions;   /* Transitions counted in the last window    */
    float    rpm;           /* Measured speed [rpm]                      */
} meas = {0};

/* Measurement window of the actual speed [ms] */
#define SPINDLE_SIM_MEAS_MS             250U

/* APB1 timer clock used as a reference if the read fails */
#define SPINDLE_SIM_TIMER_CLK_DEFAULT   170000000UL

/* ============================================================================
  * PRIVATE FUNCTIONS
  * ============================================================================ */

/**
  * @brief  Computes prescaler and auto-reload for the requested A/B frequency
  * @param  f_pwm: desired frequency of the A/B period [Hz]
  * @retval None
  * @note   With toggle on every match the waveform period is
  *         2 * (PSC+1) * (ARR+1) clock cycles, hence
  *         ARR = f_tim / (2 * (PSC+1) * f_pwm) - 1.
  *         The prescaler chosen is the smallest value that keeps ARR within
  *         16 bits, in order to preserve the maximum phase resolution.
  */
static void SpindleSim_CalcTiming(uint32_t f_pwm)
{
    uint32_t timer_clk = HAL_RCC_GetPCLK1Freq();
    uint32_t psc = 0U;
    uint32_t arr = 1U;

    /* In this project PCLK1 = HCLK (no APB divider), therefore the clock of the
       APB1 timers matches PCLK1 */
    if (timer_clk == 0U) {
        timer_clk = SPINDLE_SIM_TIMER_CLK_DEFAULT;
    }

    while (psc <= 0xFFFFUL) {
        uint32_t den = 2UL * (psc + 1UL) * f_pwm;

        arr = (den != 0U) ? (timer_clk / den) : 1UL;
        if (arr == 0U) {
            arr = 1U;
        }
        if (arr <= 0xFFFFUL) {
            break;
        }
        psc++;
    }

    /* Saturation at the limits of the two 16-bit registers */
    if (psc > 0xFFFFUL) {
        psc = 0xFFFFUL;
    }
    if (arr > 0xFFFFUL) {
        arr = 0xFFFFUL;
    }

    sim.psc = psc;
    sim.arr = arr;

    /* Actual frequency obtained from the programmed integer values */
    sim.pwm_hz = timer_clk / (2UL * (psc + 1UL) * (arr + 1UL));
}

/**
  * @brief  Writes the geometry of A and B into TIM3 and that of Z into TIM2
  * @retval None
  * @note   The compare values are written BEFORE ARR: with the ARR preload
  *         (ARPE) and the CCR preload (OCxPE) enabled, the load takes place
  *         consistently at the next update event, so no spurious
  *         transition is generated.
  *         The distance between the compare values of A and B remains (ARR+1)/2,
  *         that is T/4, a necessary condition for the four transitions to be
  *         equally spaced over the whole period.
  */
static void SpindleSim_ApplyGeometry(void)
{
    uint32_t arr  = sim.arr;
    uint32_t ccr1 = (arr + 1UL) / 4UL;              /* A: toggle at T/8                */
    uint32_t ccr2 = 3UL * (arr + 1UL) / 4UL;        /* B: shifted by T/4 from A        */

    /* Opposite direction: the two compare values are swapped, so B leads A
       by 90 degrees. Generation stays in hardware and the pins do not change.
       The direction can be changed at runtime with SpindleSim_SetDirection(); the
       initial value is selected at compile time by defining SPINDLE_SIM_DIR_REVERSE. */
    if (sim.reverse != 0U) {
        uint32_t tmp = ccr1;
        ccr1 = ccr2;
        ccr2 = tmp;
    }

    /* Prescaler and period of the timer */
    __HAL_TIM_SET_PRESCALER(&htim3, sim.psc);
    __HAL_TIM_SET_AUTORELOAD(&htim3, arr);

    /* Geometry of the two TIM3 channels */
    __HAL_TIM_SET_COMPARE(&htim3, TIM_CHANNEL_1, ccr1);
    __HAL_TIM_SET_COMPARE(&htim3, TIM_CHANNEL_2, ccr2);

    /* Z: one pulse per revolution. TIM2 is clocked by the TIM3 update events
       (External Clock Mode 1, ITR2): one A/B period is worth 2 events, therefore one
       revolution is worth 2 * SPINDLE_SIM_PPR events; the pulse lasts 2 events. The
       channel is stopped and re-armed at every geometry application. */
    (void)HAL_TIM_PWM_Stop(&htim2, TIM_CHANNEL_1);
    /* Z: one pulse per revolution. TIM2 is clocked by the TIM3 update events
       (External Clock Mode 1, ITR2): one A/B period is worth 2 events, therefore one
       revolution is worth 2 * SPINDLE_SIM_PPR events; the pulse lasts 2 events. The
       value preset below sets the phase reference. */
    __HAL_TIM_SET_PRESCALER(&htim2, 0U);
    __HAL_TIM_SET_AUTORELOAD(&htim2, (2UL * (uint32_t)SPINDLE_SIM_PPR) - 1UL);
    __HAL_TIM_SET_COMPARE(&htim2, TIM_CHANNEL_1, 2U);
    htim2.Instance->EGR |= TIM_EGR_UG;

    /* The TIM3 counter is cleared and the update event forces the loading of the
       preload registers: the new geometry takes effect consistently,
       even if the timer is running */
    __HAL_TIM_SET_COUNTER(&htim3, 0U);
    htim3.Instance->EGR |= TIM_EGR_UG;

    /* Phase of Z: TIM2 is clocked by the TIM3 update events, therefore the
       pulse starts at the clearing of its counter. The reference is the TIM3
       rollover, which precedes the rising edge of A by T/8; presetting it to
       0 locks it and makes the phase repeatable at every application. */
    __HAL_TIM_SET_COUNTER(&htim2, 0U);
    if (sim.running != 0U) {
        (void)HAL_TIM_PWM_Start(&htim2, TIM_CHANNEL_1);
    }
}

/* ============================================================================
  * PUBLIC API - INITIALIZATION
  * ============================================================================ */

/**
  * @brief  Initializes the quadrature generator (A and B on TIM3)
  * @retval None
  * @note   To be called after MX_TIM3_Init(). It sets the default speed to
  *         600 rpm (6 kHz), a convenient value for the first checks with
  *         the oscilloscope, and leaves TIM3 stopped.
  *         It also sets the initial direction, reversed if SPINDLE_SIM_DIR_REVERSE
  *         is defined at compile time.
  */
void SpindleSim_Init(void)
{
    sim.rpm     = 0.0f;
    sim.running = 0U;

#if defined(SPINDLE_SIM_DIR_REVERSE)
    sim.reverse = 1U;           /* reversed direction set at compile time    */
#else
    sim.reverse = 0U;
#endif

    (void)SpindleSim_SetRpm(SPINDLE_SIM_RPM_DEFAULT);
}

/* ============================================================================
  * PUBLIC API - SPEED
  * ============================================================================ */

/**
  * @brief  Sets the simulated rotation speed
  * @param  rpm: requested speed in revolutions per minute
  * @retval true  Speed applied
  * @retval false Invalid value (NaN)
  * @note   The A/B frequency is f_PWM = rpm * PPR / 60: at 6000 rpm this gives
  *         60 kHz on the channels and a 240 kHz counting frequency for
  *         the TIM1 of the ELS controller.
  */
bool SpindleSim_SetRpm(float rpm)
{
    uint32_t f_pwm;

    /* The comparison with itself rejects NaN without using any library */
    if (!(rpm == rpm)) {
        return false;
    }

    /* Saturation to the simulatable speed range */
    if (rpm < SPINDLE_SIM_RPM_MIN) {
        rpm = SPINDLE_SIM_RPM_MIN;
    }
    if (rpm > SPINDLE_SIM_RPM_MAX) {
        rpm = SPINDLE_SIM_RPM_MAX;
    }

    /* f_PWM = rpm / 60 * PPR, rounded to the nearest integer value */
    f_pwm = (uint32_t)(((rpm * (float)SPINDLE_SIM_PPR) / 60.0f) + 0.5f);
    if (f_pwm == 0U) {
        f_pwm = 1U;
    }

    SpindleSim_CalcTiming(f_pwm);
    SpindleSim_ApplyGeometry();

    /* The reported speed is the one derived from the registers actually
       programmed: the bench log always reflects the hardware */
    sim.rpm = ((float)sim.pwm_hz * 60.0f) / (float)SPINDLE_SIM_PPR;

    return true;
}

/**
  * @brief  Reads the speed that has been set
  * @retval Speed in revolutions per minute
  */
float SpindleSim_GetRpm(void)
{
    return sim.rpm;
}

/**
  * @brief  Reads the actual frequency of the A/B signals
  * @retval Frequency in Hz
  */
uint32_t SpindleSim_GetPwmHz(void)
{
    return sim.pwm_hz;
}

/**
  * @brief  Measures the actual speed by observing the TIM3 counter
  * @retval Measured speed in revolutions per minute, or -1.0f if not available
  * @note   Between two consecutive transitions of A or B the TIM3 counter
  *         travels (ARR/2)+1 ticks, therefore the crossings counted in a
  *         known window are proportional to the speed. Counting succeeds
  *         only if the main loop calls this function more often than once
  *         per half period (about 4.2 us at maximum speed): if the loop
  *         performs other work the estimate is lower than the real value, while
  *         SpindleSim_GetRpm() always reports the programmed speed.
  */
float SpindleSim_MeasureRpm(void)
{
    uint32_t now;
    uint32_t dt;
    uint32_t acc;
    uint16_t half;
    uint16_t cnt;
    uint16_t delta;

    if (sim.running == 0U) {
        meas.rpm = -1.0f;
        return meas.rpm;
    }

    /* Half period: interval between two consecutive counter transitions */
    half = (uint16_t)((sim.arr / 2UL) + 1UL);
    if (half == 0U) {
        return -1.0f;
    }

    /* The counter is read at EVERY call, not only at the end of the window: the main
       loop runs much faster than the signal, so no crossing is
       lost. Every crossing leaves a carry in the accumulator,
       and the carry is what gets counted. */
    cnt   = (uint16_t)(TIM3->CNT % half);
    delta = (uint16_t)((cnt + half - meas.last_cnt) % half);

    acc              = meas.accum + (uint32_t)delta;
    meas.accum       = acc % (uint32_t)half;        /* remainder for the next call      */
    meas.transitions += acc / (uint32_t)half;       /* crossings in the window          */
    meas.last_cnt    = cnt;

    /* The estimate is updated at the end of the window, with the time actually
       elapsed: rpm = crossings * 60 / (counts_per_period * PPR * dt) */
    now = HAL_GetTick();
    dt  = now - meas.last_tick;
    if (dt < SPINDLE_SIM_MEAS_MS) {
        return meas.rpm;
    }

    meas.rpm = ((float)meas.transitions * 60.0f)
             / ((float)SPINDLE_SIM_COUNTS_PER_PERIOD
                * (float)SPINDLE_SIM_PPR
                * ((float)dt / 1000.0f));

    meas.transitions = 0U;
    meas.last_tick   = now;

    return meas.rpm;
}

/**
  * @brief  Sets the simulated rotation direction
  * @param  reverse: true reverses the direction, false restores the normal direction
  * @retval true  Direction changed and geometry re-applied
  * @retval false Direction already set to that value (no change)
  * @note   The direction is reversed by swapping the two compare values of the
  *         A and B channels: the pins do not change and the generation stays in
  *         hardware. The change takes effect immediately even while rotating.
  */
bool SpindleSim_SetDirection(bool reverse)
{
    uint8_t nuovo = (reverse != false) ? 1U : 0U;

    if (nuovo == sim.reverse) {
        return false;
    }

    sim.reverse = nuovo;

    /* The geometry must be re-applied at once: the swap of the compare values has
       no effect until it is reloaded into the registers */
    SpindleSim_ApplyGeometry();

    return true;
}

/* ============================================================================
  * PUBLIC API - START AND STOP
  * ============================================================================ */

/**
  * @brief  Starts the simulated rotation
  * @retval None
  * @note   A and B belong to the same timer, therefore the enabling order
  *         does not affect the phase: the two outputs appear on the same counter
  *         and are already aligned with each other. Z is on TIM2, which is counted by the
  *         TIM3 update events (not by an edge of B): the reference is the rising edge of A, T/8 earlier, so the first pulse is in phase.
  *         Enabling uses HAL_TIM_PWM_Start(), which enables the channel and starts
  *         the counter regardless of the compare mode that has been set.
  */
void SpindleSim_Start(void)
{
    if (sim.running != 0U) {
        return;
    }

    /* TIM3 counter cleared: it is the phase reference of Z */
    __HAL_TIM_SET_COUNTER(&htim3, 0U);

    /* Phase of Z: TIM2 is clocked by the TIM3 update events; the pulse starts
       at the clearing of its counter, T/8 before the rising edge of A. The
       counter is cleared to lock the reference. */
    htim2.Instance->EGR |= TIM_EGR_UG;
    __HAL_TIM_SET_COUNTER(&htim2, 0U);

    /* Clears the state of the meter so that the stopped time is not counted */
    meas.last_tick   = HAL_GetTick();
    meas.last_cnt    = 0U;
    meas.accum       = 0U;
    meas.transitions = 0U;
    meas.rpm         = -1.0f;

    (void)HAL_TIM_PWM_Start(&htim3, TIM_CHANNEL_1);
    (void)HAL_TIM_PWM_Start(&htim3, TIM_CHANNEL_2);
    (void)HAL_TIM_PWM_Start(&htim2, TIM_CHANNEL_1);

    sim.running = 1U;
}

/**
  * @brief  Stops the simulated rotation
  * @retval None
  * @note   It disables the A, B and Z outputs and clears the counters, so that a
  *         restart always begins from the same reference angle.
  */
void SpindleSim_Stop(void)
{
    (void)HAL_TIM_PWM_Stop(&htim3, TIM_CHANNEL_1);
    (void)HAL_TIM_PWM_Stop(&htim3, TIM_CHANNEL_2);
    (void)HAL_TIM_PWM_Stop(&htim2, TIM_CHANNEL_1);

    __HAL_TIM_SET_COUNTER(&htim3, 0U);


    meas.last_cnt    = 0U;
    meas.accum       = 0U;
    meas.transitions = 0U;
    meas.rpm         = -1.0f;

    sim.running = 0U;
}

/**
  * @brief  Checks the state of the generation
  * @retval true  Simulated rotation in progress
  * @retval false Timer stopped
  */
bool SpindleSim_IsRunning(void)
{
    return (sim.running != 0U);
}

#if (Z_SIGNAL_MODE != 0)
/* Test values of mode 2 (rpm), chosen to cover the limits of the 50-1600
   speed range and the linearity of the chain: 50 = minimum, 153.3 = value
   measured on the bench, 1600 = maximum. */
static const float z_test_steps[] = { 50.0f, 153.3f, 300.0f, 600.0f, 900.0f, 1200.0f, 1600.0f };
#define Z_TEST_STEP_COUNT   (sizeof(z_test_steps) / sizeof(z_test_steps[0]))

/**
  * @brief  Applies the test speed in place of the one coming from the knob.
  * @param  None
  * @retval None
  *
  * It must be called once per main loop cycle. It changes speed only when the
  * target value changes: SpindleSim_SetRpm() clears the TIM3 counter and
  * reprograms the geometry, so calling it at every cycle would restart Z
  * continuously and would falsify the measurement.
  */
void SpindleSim_TestTask(void)
{
    static uint32_t last_ms = 0U;
    static uint8_t  step    = 0U;
    static float    applied = 0.0f;
    float target;

#if (Z_SIGNAL_MODE == 2)
    uint32_t now = HAL_GetTick();

    if (last_ms == 0U) {
        last_ms = now;                      /* first call: start from step 0          */
    }
    if ((now - last_ms) >= Z_SIGNAL_DWELL_MS) {
        last_ms = now;                      /* step expired: the sequence advances and repeats    */
        step++;
        if (step >= Z_TEST_STEP_COUNT) {
            step = 0U;
        }
    }
    target = z_test_steps[step];
#else
    target = Z_SIGNAL_RPM;                  /* mode 1: single value      */
#endif

    /* In verification mode the machine must be running: SpindleSim_SetRpm() acts
       on the geometry only and does not start the module, so the start is performed below. In the
       normal path the start is performed by KnobInput_ApplyPosition(), which is not
       executed here because the knob must not command. */
    if (!SpindleSim_IsRunning()) {
        SpindleSim_Start();
    }

    if (target != applied) {                /* only on changes: Z does not restart      */
        applied = target;
        (void)SpindleSim_SetRpm(target);
    }
}
#endif
